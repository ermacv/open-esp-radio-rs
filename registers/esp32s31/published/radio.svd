# ESP32S31_RADIO register map
Vendor: Espressif; Series: ESP32-S31; File version: 3.52
Recovered ESP32-S31 modem/radio core plus the minimum platform dependencies no longer delegated to an external platform PAC. Unclaimed MODEM_LPCON, PMU and HP_SYS_CLKRST words remain platform-owned. I2C_ANA_MST, PMU_RADIO, HP_SYS_CLKRST_RADIO, MODEM_SYSCON_RADIO, MODEM_LPCON_SHARED_CLOCK, MODEM_LPCON_PHY_TICK, LP_AON_CLKRST, LP_PERICLKRST and LP_TSENS are canonical reviewed radio-PHY dependencies. These are independently decoded MMIO windows, not one monolithic radio peripheral. Covered functions include PHY-PBus, PHY-I2C, IQ estimation, RX-DCO, cold deadlines, temperature sensing, Wi-Fi MAC RX-DMA and receive BlockAck. Unknown fields are omitted; OPAQUE and UNKNOWN names describe instruction-level evidence without assigning an unproven hardware meaning.
Registers are 32-bit, read-write, no defined reset value unless marked. A register's access mark holds for its fields unless they carry their own. Offsets are from the block's base; lines under a group give offsets from that group; [hi:lo] are bit positions; {n}, {i} and the like mark numbered series; 'fields as' and 'values as' point back to an identical list; <NAME> marks a mode.

## Memory map
0x20100000 PHY_FREQUENCY_CHANNEL_ORACLE — Frequency-memory, hardware channel-switch, NRX and channel-bandwidth registers recovered from complete finite ROM/blob bodies. Names retain UNKNOWN where the instructions prove a field but not its electrical meaning. One physical word has one identity even when a bit has different mode-dependent roles.
0x20100000 PHY_AGC_ORACLE — OPAQUE PHY AGC, PBus-pulse, antenna, RX-compensation, DC-memory, post-initialization and 11b-control registers recovered from complete, finite rev0 ROM/blob bodies. One physical register has one identity even when independent bodies prove different fields. Names describe their proven operation role, not an unevidenced electrical identity.
0x20100000 WIFI_PHY_RATE_ORACLE — Wi-Fi-owned PHY words: the noise-floor measurement read by Wi-Fi link policy and the low-rate receive gate of Wi-Fi rate control and 11b long-range RX. Only Wi-Fi touches these words: no PHY registration, calibration or tracking body and no Bluetooth or IEEE 802.15.4 body accesses them, so they belong to the Wi-Fi partition rather than the shared radio PHY. They share the radio-core base with the PHY oracles.
0x20100000 PHY_BASEBAND_CONFIG_ORACLE — PHY/baseband configuration registers recovered from complete rev0 ROM bodies and complete pinned libphy leaves. Operation-derived fields keep UNKNOWN where neither public documentation nor an independent symbol establishes the electrical meaning.
0x20100000 PHY_IQ_ESTIMATOR_ORACLE — DC/IQ estimator configuration, signed result and activity registers recovered from complete S31 rev0 ROM bodies and the complete pinned phy_check_rx_sat blob leaf. Unknown electrical roles remain explicit.
0x20100000 PHY_RX_DCO_ORACLE — RX-DCO calibration control word recovered from complete pinned S31 blob and rev0 ROM calibration bodies.
0x20100000 PHY_CLOCK_ORACLE — OPAQUE PHY clock-gate registers recovered from complete no-call ROM/blob leaves.
0x20100000 PHY_FECOEX_RECOVERED — Sparse FECOEX words absent from the public platform PAC.
0x20100000 PHY_ADC_DUMP_RECOVERED — Receive sample-dump words programmed by complete librftest adctrig and set_dump_mode. Dumped words are read back from 0x2f060000 as signed ten-bit components in bits 9:0 and 19:10 (complete print_dump_data and sampledeal); that aperture is not radio MMIO.
0x20100400 PHY_FEDATA_RECOVERED — Sparse FEDATA words absent from the public platform PAC.
0x20100800 PHY_MEMORY — Shared PHY table-memory command, data and PBUS group-boundary aperture. The same command/data words have mode-dependent PBUS-memory, TX-CFR and gain-memory meanings; fields are named only where the complete bodies prove a common or mode-independent identity.
0x20100800 PHY_FECTRL_RECOVERED — Sparse FECTRL antenna words absent from the public platform PAC.
0x20100880 PHY_PBUS — PBus command, mode, status/clock/force and packed result windows recovered from complete rev0 ROM bodies and their address/shift jump tables. The blob debug printer independently names selector/path groups: RFRX is selector 0 paths 1/2; BB is selector 1 paths 1/2; DCO is selectors 2/3 paths 1/2; RFTX is selector 4 paths 1/2 and selector 5 path 1.
0x20100C00 PHY_FEDATA_WIFI_RECOVERED — Sparse FEDATA_WIFI words absent from the public platform PAC.
0x20101000 BLUETOOTH_CONTROLLER_CORE — Bluetooth controller-core register view grouped by runtime responsibility rather than vendor object boundaries. It owns task-side scheduler, sleep-timer, controller initialization, memory-list, scan-snapshot and ISO-coexistence state reached through the 0x20101000 physical block. Interrupt programming, enable/status, acknowledgement and fault diagnostics belong exclusively to BLUETOOTH_INTERRUPT_BANK; the two scheduler words accessed by the hard handler belong exclusively to BLUETOOTH_SCHEDULER_INTERRUPT_RUNTIME.
0x20101000 BLUETOOTH_INTERRUPT_BANK — Bluetooth controller interrupt programming, enable, status, acknowledgement, snapshot and diagnostic registers. This physical view is independent from the controller task lifecycle so ownership can transfer to the hard ISR without also exposing scheduler, sleep or memory-management state.
0x20101000 BLUETOOTH_SCHEDULER_INTERRUPT_RUNTIME — Scheduler words and the MAC diagnostic-signal pair transferred with BLUETOOTH_INTERRUPT_BANK to the primary hard handler. The source-124 reference gate samples scheduler BUSY through the diagnostic pair and can write a complete zero image to SCHEDULER_REFERENCE; the later deferred-work observation reads SCHEDULER_STATE. Task-side scheduler transactions borrow this owner for their own BUSY samples, which serializes every selector write with its value reads. Keeping this sparse physical view outside the task-side controller partition prevents either owner from manufacturing an MMIO alias.
0x20101400 BTMAC_BLE_PHY_INIT — ESP32-S31 BTMAC words initialized by the complete BLE PHY register-init function. The function identity is supported by the matching ble_phy.c object layout from the ESP32-C61 ecosystem library, while every address, mask and value below comes only from the ESP32-S31 artifact. Neutral INIT names retain the exact operation without promoting the cross-chip hint to hardware truth.
0x20101424 BLE_ISO_SCHEDULER_NOTIFY — Narrow late-feature owner for the command written by two complete ISO-path functions. A positional capability is intentional: the observed write strobe is exact, while the undocumented hardware action is not inferred from the software queue context.
0x20101550 BLUETOOTH_RESET_IDLE_STATUS_0 — One independently bounded Bluetooth baseband reset-idle status word. The complete bbmac_idle_for_swrst leaf proves the exact predicate but neither address adjacency nor the function name proves a wider physical block.
0x2010180C BLE_CONTROLLER_ADDRESS_SLOTS — Three positional six-byte controller address slots. A complete ESP32-S31 ble_phy.c leaf proves the selector range, pair stride, byte packing and write order. Named callers identify public-address use of slot zero and random-address use of slot one; slot two remains intentionally unnamed.
0x20101878 BLE_SYNC_PUBLICATION — Two positional write-only words used by one ble_lll_sync.c path. The source identity records software context only; the register names deliberately do not turn that context into an undocumented hardware meaning.
0x20101880 BLE_HW_RESOLVING_LIST — Narrow owner for the standalone BLE resolving-list base publication. The complete ESP32-S31 ble_hw.c leaf proves one compressed SRAM pointer word but does not prove that adjacent BTMAC addresses belong to the same logical block.
0x20101970 BLE_SCAN_BACKOFF — Scan-backoff state of the Link Layer scanner (Core Specification Vol 6, Part B, 4.4.3.2). Scanner start publishes the maximum upper limit and initializes the two hardware-maintained backoff words to one; a vendor test command reads those two words back as nine-bit values. Which word is the backoff count and which the upper limit is not established.
0x2010199C BLE_HW_CTE_RING_CONTROL — Direction-finding ring state recovered from complete ESP32-S31 ble_hw_cte.c leaves. Ordinary advertising, scanning and connection link states retain a controller-global disabled-CTE descriptor even when IQ sampling is not requested, so the baseline pointer and ownership fields are part of the minimum standalone BLE controller.
0x20101B00 BLE_HW_RUNTIME_CONTROL — Sparse BLE hardware status/clear and runtime-configuration view. Complete ESP32-S31 functions prove the array geometry, access directions and exact configuration images. Positional names retain unknown source and field semantics instead of promoting diagnostic strings to hardware truth.
0x20101FF0 BLE_HW_POSITIONAL_WORD_1FF0 — Narrow owner for the otherwise unbounded word at 0x20101FF0. Complete ESP32-S31 BLE PHY initialization writes complete image zero followed by complete image one before touching any other radio register. The same ordered writes appear at the same block offset in the named ESP32-C61 counterpart, but neither artifact proves this word's hardware action or membership in the adjacent BTMAC dump range. No wider peripheral extent is claimed.
0x20102000 BT_V3_2_BASEBAND — Bluetooth baseband control and status words recovered from complete, named bt_bb_v2.o accessors in the ESP32-S31 vendor library. Field geometry and argument-to-field transforms are exact. ARGUMENT_N labels deliberately retain unknown C signature semantics rather than inventing a hardware meaning.
0x20102000 BT_V3_2_CTE — Bluetooth direction-finding control words recovered from complete, independently named CTE accessors in the ESP32-S31 vendor baseband library. Only fields touched by those accessors are described; untouched bits remain unassigned.
0x20102010 SHARED_BASEBAND_TX_TIMING — One physical baseband timing word reached by the common BTBB initializer. The named vendor leaf carries a historical Zigbee prefix, but the current evidence proves only the exact shared initialization transaction and does not grant protocol-exclusive ownership.
0x20102800 PHY_BTAGC_RECOVERED — Sparse BTAGC words absent from the public platform PAC.
0x20102C00 ZBBB_RADIO_CONTROL — Independently bounded words in the ZBBB window touched by complete Bluetooth baseband receive-setup and reset-idle leaves. Names describe only those exact operations; they do not claim that the physical block is owned exclusively by Bluetooth or assign a wider ZBBB protocol meaning.
0x20103000 IEEE802154_MAC — Dedicated ESP32-S31 IEEE 802.15.4 MAC aperture at 0x20103000. This selective foundation publishes only register geometry exercised by the pinned public common/chip LL accessors. The public struct and register headers still carry TODO ZB-93 pending an authoritative regdesc CSV, so untouched DTM, timing, debug-selector and modem-sleep words remain deliberately absent and no reset values are claimed.
0x20103088 SHARED_BASEBAND_RESET_IDLE_STATUS — One independently bounded shared-baseband reset-idle status word. The complete Bluetooth bbmac_idle_for_swrst leaf proves the exact predicate, but its location inside another protocol aperture prevents Bluetooth-exclusive ownership.
0x20104000 WIFI_MAC_BSSID_POLICY — Per-interface BSSID address and policy words used by scan and associated-STA receive filtering.
0x20104000 WIFI_MAC_RX_DMA — Descriptor-walker registers recovered from complete rev0 ROM leaves and qualified with the open driver's rotating 32-entry RX ring.
0x20104020 WIFI_MAC_HE_INIT_SUFFIX — Complete hardware-visible hal_he_init suffix after dbg_read_tx_power, including all reached leaves. It contains 163 ordered writes/RMWs plus the two multi-BSSID guard reads.
0x20104040 WIFI_MAC_HE_COLOR_COLLISION — Complete dbg_read_color_collision reads the 64-bit observed BSS-color bitmap. Its adjacent control word is the canonical WIFI_MAC_HE_INIT_PREFIX.RX_FIELD_CONTROL register. Open HE HIL observed color bit 25, threshold one and timeout 60 seconds.
0x20104048 WIFI_MAC_HE_INIT_PREFIX — Complete hal_he_init prefix through hal_init_tb_tx, stopping immediately before hal_init_tx_pwr. Twenty-two separate RMW edges and one final synchronization/status read.
0x2010405C WIFI_MAC_INTERFACE_ADDRESS — Four interface-address pairs consumed by MAC receive filtering.
0x20104098 WIFI_MAC_RX_CSI_CONTROL — Multifunction receive/CSI word. Complete mac_last_rxbuf_init sets bit 27; complete hal_init later replaces its low and second bytes through separate RMWs.
0x201040A0 WIFI_MAC_RX_POWER_SAVE — WDEV_RX_POWER_SAVE_CONF decoded by complete dbg_read_rx_misc. Complete hal_he_set_power_save sets the interface-zero intra-PPDU and BSS-color-check bits as the tail of hal_he_bssid_init; open associated-STA HIL read both bits set.
0x201040A8 WIFI_MAC_RX_END_STATE — Receive-end state word returned by the complete hal_mac_rx_get_end_state and hal_mac_rx_get_end_info leaves.
0x201040D8 WIFI_MAC_RX_FILTER — Four WDEVRX_ABORT receive-queue policy words. Complete dbg_read_rx_misc names every used bit through 19; queue three is also the complete promiscuous-sniffer control word.
0x201040FC WIFI_MAC_TXRX_PREFIX — Eighteen direct fresh-read RMW edges before the first external HE callback in complete mac_txrx_init; complete hal_init later repeats the bit-28 set edge.
0x20104110 WIFI_MAC_RX_BSSID_LIST — Canonical WDEVRXCTR_BSSIDLIST word. Complete dbg_read_rx_misc names bits 19:18 RXCTL9_BSSID_POS; the HE init prefix independently writes encoding two to that same field.
0x20104120 WIFI_MAC_LAST_RX_BUFFER — Six three-word last-RX-buffer entries and their shared two-edge enable control, recovered from the complete mac_last_rxbuf_init leaf.
0x2010429C WIFI_MAC_INTERNAL_TX_BLOCK_ACK — Complete dbg_read_internal_txba reads one internal WDEVTXBA result: a 64-bit bitmap, two transmitter-address words and a combined fragment/starting-sequence/TID word.
0x201042B0 WIFI_MAC_ANTENNA_INIT — Complete hal_attenna_init transaction. The misspelled vendor symbol first visits eight reverse-stride queue/vector words, then updates one common word.
0x201042B4 WIFI_MAC_STA_BEACON_FILTER — Station beacon-filter control word recovered from the complete enable and disable leaves. The three low bits are toggled together; individual hardware meanings remain unknown.
0x201042FC WIFI_MAC_COEX_INIT — Complete COEX/PTI tail of hal_init and complete setter leaves. PTI values remain platform-supplied because the coexistence table may be changed at runtime.
0x20104300 WIFI_MAC_BEACON_IE_CRC — Full beacon-IE CRC/result word returned through the caller output pointer by complete hal_beacon_ie_crc_get.
0x20104308 WIFI_MAC_TXRX_SUFFIX — Eight Wi-Fi-owned direct fresh-read RMW edges after the three external HE callbacks in complete mac_txrx_init. The ninth edge reaches the independently shared physical word at 0x20104C24 and is modeled by SHARED_RADIO_INIT_CONTROL.
0x2010430C WIFI_MAC_RX_STATISTICS — Sparse RX hardware statistics decoded by complete dbg_read_rx_count. Ten-bit and sixteen-bit masks, the signed CFO transform and every register address below follow the complete instruction body and its pinned format string. Open HE HIL observed coherent MPDU/end/data, CFO, FCS, power-drop, HT-SIG, HE-SIG-A and interrupt counts while all buffer/FIFO/TKIP counters remained zero.
0x201043A0 WIFI_MAC_HE_TB_STATISTICS — Hardware counters read by the complete hal_he_get_rx_trigger_cnt, hal_he_get_tb_times_cnt and hal_he_get_tb_qosnull_cnt leaves. These counters distinguish Trigger reception from actual trigger-based transmission and appended QoS Null responses. An ordinary controlled HE SU AP produced no Trigger frames, so all three remained zero during sustained HE DCM A-MPDU traffic.
0x201043B4 WIFI_MAC_DIAGNOSTIC_STATISTICS — Complete libpp.a[pp_debug.o]::dbg_lmac_diag_statis_dump ties the blob's diag0 through diag12 and diagsel labels to these sparse MMIO words. The non-contiguous geometry and absence of diag11 are properties of the complete body. Higher-level meanings and internal bit widths remain unknown.
0x20104408 WIFI_MAC_TX_POWER_INIT — Complete hal_init_tx_pwr consumes 43 two-byte PHY power results, then complete TB, immediate-response and TB-RU leaves publish 56 ordered fresh-read RMW edges. Runtime partial-RU get/set APIs select the same packed fields by the raw Trigger RU allocation. Values are PHY gain-table indices, not dBm.
0x2010444C WIFI_MAC_TXRX_CALLBACKS — Hardware effects of the three HE callbacks between the direct mac_txrx_init prefix and suffix. Diagnostic logging calls are intentionally omitted.
0x201044F4 WIFI_MAC_HE_TB_DIAGNOSTICS — Four read-only hardware result words decoded by complete dbg_read_axtb_diag and its four complete getter leaves. The names come from the pinned blob's own format strings; no field meaning is inferred from reset images. All four words remained zero when the controlled AP sent no Trigger frames.
0x20104508 WIFI_MAC_HE_TRIGGER_RX_DIAGNOSTICS — Ten hardware diagnostic words decoded by complete dbg_read_ax_diag. The blob explicitly warns that these words are not latched and can be updated by a following RX frame; consume them only as best-effort diagnostics adjacent to a known Trigger reception.
0x20104800 WIFI_MAC_CRYPTO_CONTROL — Per-interface hardware-crypto controls, shared policy mask and key validity bitmap recovered from complete libpp hal_crypto leaves.
0x20104C00 WIFI_MAC_CORE_ENABLE — Shared MAC enable gate recovered from the complete hal_enable_mac and hal_disable_mac leaves. The four individual disable-bit meanings are not independently known.
0x20104C24 SHARED_RADIO_INIT_CONTROL — One physical radio word independently reached by Wi-Fi MAC initialization and Bluetooth receive setup. The owner is protocol-neutral because the two consumers update disjoint fields through fresh-read RMW operations; the name records the observed setup context without assigning an undocumented electrical meaning.
0x20104C40 WIFI_MAC_INTERRUPT — Wi-Fi MAC interrupt mask, masked status and write-to-clear aperture. The two complete hal_mac leaves independently prove the status and clear addresses. The recovered common FIQ and cold initializer prove the event-bit mapping and mask transaction used by the open ISR.
0x20104C5C WIFI_MAC_TX_COMMON — Shared Wi-Fi CCA, timeout and completion state used by MAC transmit queues and the PHY-owned Wi-Fi CCA gate.
0x20104C64 WIFI_MAC_RX_HANG_STATISTICS — Complete dbg_read_rx_count decodes two eight-bit hang counters and two full-width combined hang/panic counters. All four remained zero during the connected open HE matrix baseline.
0x20104CA4 WIFI_MAC_RX_CUSTOM_TYPE — WDEVTXRX_TAB three custom frame-type match and ACK-index profiles decoded by complete dbg_read_rx_misc.
0x20104CAC WIFI_MAC_CONTROL — Shared MAC run/stop control. The cold open-RX frontier publishes zero; the complete vendor channel-switch chain requests quiescence here and later restarts the no-power-save profile.
0x20104D34 WIFI_MAC_TX_QUEUE_CONTROL — Four ascending physical banks represent logical EDCA queues 3,2,1,0.
0x20104D74 WIFI_MAC_HE_BUFFER_STATUS — Eight interleaved hardware/software Buffer Status Report values and their shared control. Complete dbg_read_bsr_info names every exposed field. Complete hal_he_get_hw_txq_bsr independently proves the eight-byte stride and low twenty-bit hardware value. The independent blob and ROM libpp[hal_mac_tx.o]::mac_tx_set_tb and rom[]::mac_tx_set_tb bodies prove the write-side scheduler interpretation: for logical queues zero through three they replace the corresponding software BSR low twenty bits with the sum of every linked frame-state halfword at offset 0x22, then OR the queue bit into CONTROL[7:0]. Complete dbg_read_tx_ppdu independently names that exact halfword msdu_len, proving that this is an original-MSDU byte sum rather than MPDU, PSDU or encoded A-MPDU length. Complete HE BlockAck response/deletion paths separately select and clear TID_BITMAP bits through hal_he_set_tid_bitmap and hal_he_clr_tid_bitmap. Open HE HIL observed TID_BITMAP=1 immediately after the successful TID0 AddBA transition while sustained DCM A-MPDU remained clean. A later rev0 HIL reproduced the complete ROM write order with a 47104-byte TID0 queue: CONTROL validity read back one while SOFTWARE_BSR already read zero. This qualifies the write-side address and validity edge but leaves the zero as a live-update/read-latch ambiguity until a real AP Trigger is observed.
0x20104DBC WIFI_MAC_HE_MU_EDCA_TIMER — Four MU-EDCA timer words decoded by complete dbg_read_muedca_timer. Durations are reported by the blob in eight-TU units. Complete blob and ROM libpp[hal_mac_tx.o]::mac_tx_set_tb and rom[]::mac_tx_set_tb set ENABLE in the timer selected by the logical TX queue before publishing the Trigger queue configuration. After open HE association and TID0 AddBA, all four ordinary-SU baseline words had ENABLE=0, TIMER/CURRENT/AIFS=0 and REACHED=1; that pre-port baseline AP emitted no Trigger frame.
0x20104DE0 WIFI_MAC_COLD_HANDSHAKE — Cold MAC initialization request/ready handshake and the adjacent two WDEV timer targets recovered from complete ROM leaves.
0x20104E00 WIFI_MAC_BEAMFORMING_FEEDBACK_TEST — Test-only beamforming-feedback selector written by complete esp_test_bf_set_feedback. The write transforms and selector branches are exact; the public meaning of selector values zero through sixteen is not present in the archive, so only bounded functional names are assigned.
0x20104E08 WIFI_MAC_TX_STATISTICS — Complete libpp.a[pp_debug.o]::dbg_lmac_hw_statis_dump reads these four consecutive words and prints them as txrts, txcts, track and trcts. It then reads the already canonical RX_TX_HANG/PANIC words at 0x20104e18/1c under its shorter txhung/panic labels. The blob applies no masks; the SVD therefore preserves each word without inventing subfields.
0x20104E28 WIFI_MAC_RX_RUNTIME_RESULTS — Sparse receive statistics-clear and end-result words recovered from complete hal_sniffer_rx_clr_statistics and hal_mac_rx_get_end_info leaves.
0x20104E9C WIFI_MAC_HE_OBSS_NARROW_BAND_RU — Complete hal_he_disable_obss_narrow_bw_ru writes either all ones or zero into the twenty-bit bitmap and independently sets or clears a five-bit class group and the global disable bit. The leaf name proves the aggregate disable function; individual bitmap/class identities remain approximate.
0x20105364 WIFI_MAC_TX_QUEUE_VECTOR — Four 0x7c-byte physical vector banks represent logical EDCA queues 3,2,1,0. The write-side Trigger-based path additionally publishes the tail of its linked MPDU-length list in the word between HE-SIG-A2 and POWER.
0x201053B0 WIFI_MAC_TX_COMPLETION — Non-aliased words from four 0x7c-byte completion banks representing logical EDCA queues 3,2,1,0. AUX_A/AUX_B are canonically described by the richer TX BlockAck high-address and TX queue-information registers in WIFI_MAC_RX_DMA.
0x20105800 WIFI_MAC_KEY_TABLE — Twenty-five entries of ten 32-bit words. Complete hal_crypto_clr_key_entry proves the 0x28-byte stride and all ten ordered stores; set/get leaves prove the peer/control/key layout.
0x20105F94 WIFI_MAC_BEAMFORMING_REPORT — Complete esp_test_get_bfr_avgsnr reads the low byte at 0x20105f94 as stream-zero average-SNR code. Code 0x7f is a special saturated/invalid value rendered with a greater-than-or-equal prefix; every other code is converted to dB as (code + 88) / 4.
0x20107000 PHY_AGC_RECOVERED_GAPS — Sparse AGC words absent from the public platform PAC.
0x20107800 PHY_NRX_RECOVERED_GAPS — Sparse NRX words absent from the public platform PAC.
0x20107C00 PHY_BB_RECOVERED_GAPS — Sparse BB words absent from the public platform PAC.
0x20108000 PHY_BRX_RECOVERED_GAPS — Sparse BRX words absent from the public platform PAC.
0x20108800 MODEM_ETM — ESP32-S31 modem event-task matrix at MODEM_BASE + 0x8800, shared by the IEEE 802.15.4 and Bluetooth lifecycles. The public IEEE 802.15.4 driver names the channel-enable, set and clear words and the per-channel event/task pair at an eight-byte stride, and programs channels zero and one; the BTDM runtime programs channels four through seven through the same words. Channel bits and identifiers without a reviewed user remain absent and no reset values are claimed.
0x2010891C BLE_HW_POSITIONAL_WORD_891C — Narrow owner for the otherwise isolated word at 0x2010891C. Complete ESP32-S31 BLE PHY initialization writes complete image 0x20 before initializing the BLE hardware accelerator and complete image 0x40 after the surrounding BTMAC and accelerator sequence. The register's physical block, hardware action and the meanings of the two images remain unproved, so no neighboring 0x201088xx words are absorbed.
0x20109800 BLE_HW_ACCELERATOR — Sparse ESP32-S31 BLE hardware-accelerator view. Complete ble_hw.c operations independently prove encryption and resolving-list engines in this physical block; complete BLE PHY initialization proves three additional initialization words. Cross-chip objects provide function identities only. Addresses, field geometry, values, ordering and predicates all come from ESP32-S31 bytes.
0x20109C00 MODEM_SYSCON_RADIO — Route-owned MODEM_SYSCON clocks, resets and shared Wi-Fi-baseband control used by the exclusive Wi-Fi, Bluetooth and IEEE 802.15.4 lifecycles.
0x2010B000 BTDM_SCHEDULER_TABLE — Sixteen-entry scheduler hardware-list table. Complete current insertion-begin, insertion-end and lifecycle bodies prove the finite entry count, 0x10-byte stride and low-20-bit compressed SRAM head. Same-chip public named header accessors independently establish the hardware-list role. The upper twelve bits and the unobserved words inside each stride remain unknown.
0x2010D000 BTDM_RUNTIME_CONTROL — Sparse BTDM low-level runtime and sleep-control window. Complete ESP32-S31 functions prove only the recorded access directions, finite images, low-24-bit publications and four isolated RMW controls. The independently role-mapped runtime-timer start command is named; all other positional names deliberately avoid assigning undocumented peripheral semantics.
0x2010D800 WIFI_MAC_LOCAL_TIME — Free-running Wi-Fi MAC local-time counter, read-only and without read side effects. Complete libpp[lmac.o]::lmacAdjustTimestamp subtracts the receive timestamp a received frame carries from this word as the frame's age and, while the station slept, rewrites that timestamp as this word minus a TU-scaled sleep interval; libpp[pm_twt.o]::pm_twt_set_target_wdev_time, libpp[pm_coex.o]::pm_get_null_max_tx_time and libpp[pm_coex.o]::pm_coex_recalculate_wifi_time_slice read it as the MAC's current time. The PHY SDM deadline samples the same word. Its unit and rate against the system timer are not established.
0x2010D80C WIFI_MAC_TSF_STATUS — Station TSF activity status recovered from the complete no-call hal_is_sta_tsf_active leaf. The instruction body proves the address and bit geometry but not the hardware transition rules.
0x2010D814 WIFI_MAC_STA_TSF_LOAD — Shared TSF load and coherent station/SoftAP snapshot transaction.
0x2010D82C WIFI_MAC_STA_TBTT_TARGET — Station TBTT target word recovered from complete hal_set_sta_tbtt. The low 26-bit packing from the supplied 64-bit TSF value is exact; the hardware counter unit remains unnamed.
0x2010D830 WIFI_MAC_RTC_TIMER_UPDATE — Complete enabled path of hal_timer_update_by_rtc, reached from complete hal_init with enable one and the OS-adapter slow-clock calibration value.
0x2010D83C WIFI_MAC_REGDMA_CONTROL — Shared WDEVPWR control word. The channel-change leaf proves the REGDMA selector, while complete modem-power leaves prove the wake-protect lead time and TBTT auto-period fields. Hardware interactions between these fields remain unqualified.
0x2010D860 WIFI_MAC_AUX_TSF_CONTROL — SoftAP, NAN and broadcast-TWT TSF control words. Complete public leaves prove their addresses and exact enable/mode masks; unrelated bits and hardware transition rules remain unnamed.
0x2010D87C WIFI_MAC_TSF_TIMER — Four-entry TSF timer bank recovered from all complete target, wakeup and enable/disable leaves. Each entry consists of one control word followed by its 32-bit target. The public index is guarded to zero through three by the target and timer-enable leaves; the dedicated wakeup leaves do not contain their own range check.
0x2010D89C WIFI_MAC_COEX_RUNTIME — Runtime receive-beacon and individual-TWT COEX/PTI words recovered from five complete hal_coex.o leaves. Register addresses, masks and RMW order are exact; fields whose electrical meaning is not established retain UNKNOWN names.
0x2010D8B4 WIFI_MAC_POWER_INTERRUPT — WDEVPWR interrupt bank named by complete print_isr_regs. Complete hal_pwr_interrupt_get_event and hal_pwr_interrupt_clr_event independently prove the masked STATUS read and full-width CLEAR acknowledgement transaction. Complete TSF timer enable/disable leaves update the timer interrupt masks in ENABLE and clear stale events through CLEAR.
0x2010F000 MODEM_LPCON_SHARED_CLOCK — Role-neutral MODEM_LPCON clock-map, gate and low-power selector registers shared by the exclusive Wi-Fi, Bluetooth and IEEE 802.15.4 routes.
0x2010F000 MODEM_LPCON_PHY_TICK — Role-neutral MODEM_LPCON tick target used by the reviewed common-PHY prelude. Other MODEM_LPCON registers remain platform-owned.
0x2010F400 COEX_HW_TIMER — Six-entry coexistence timer bank. Complete libcoexist leaves address entry index as 0x2010f400 + index*0x10. The 48-event libcoexist[coexist_core.o]::coex_core_timer_idx_get table of the pinned archive returns timer indices zero through five or 0xff; index five is used only by the PHY grant-protect event 48.
0x2010F49C COEX_EXTERNAL — External coexistence control beside the coexistence timer bank. The complete hal_external_coexist.o leaves of the pinned libcoexist address these words at 0x2010f49c, 0x2010f4a0, 0x2010f4a4, 0x2010f4d0 and 0x2010f4d8 through fresh-read RMW operations; the GPIO matrix routing of the request, priority, grant and TX-line signals belongs to the platform, not to this block.
0x2010F800 I2C_ANA_MST — Shared ESP32-S31 analog-register I2C master owned by the affine radio-PHY lifecycle.
0x2010FC00 PHY_I2C_COMMAND_RAM — Official S31 reg_base.h names this aperture DR_REG_I2C_ANA_MST_MEM_BASE. The complete blob establishes its forty-five-entry command layout and the population order in phy_i2c_master_cmd_mem_init. Complete phy_i2c_check independently names ten logical banks, their block IDs, selected host and finite register-index ranges.
0x20585210 IEEE802154_INTERRUPT_ROUTE — The two CPU interrupt-matrix words for ESP32-S31 modem source 132 (MODEM_ZB_MAC). This source-specific view is retained with the IEEE 802.15.4 owner and publishes only the generated field readers needed to prove that a polled or validation transaction starts with both CPU routes detached.
0x20587000 HP_SYS_CLKRST_RADIO — Route-owned high-power system clock/reset words shared by the reviewed Wi-Fi, Bluetooth and IEEE 802.15.4 lifecycles. Unrelated HP_SYS_CLKRST words remain platform-owned.
0x20701000 LP_AON_CLKRST — Low-power always-on clock/reset registers reached by the reviewed PHY power-detector lifecycle.
0x20704000 PMU_RADIO — Route-owned PMU words used by the reviewed shared radio clock, RF-power and analog-I2C lifecycles. Unrelated PMU words remain platform-owned.
0x20710000 LP_PERICLKRST — Low-power peripheral clock/reset registers reached by the reviewed PHY temperature-sensor initializer.
0x20818000 LP_TSENS — Low-power temperature sensor reached by reviewed complete ROM and libphy bodies.

## Licence text in the file
MIT OR Apache-2.0
