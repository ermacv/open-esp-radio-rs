# ESP32C5_RADIO register map
Vendor: Espressif; Series: ESP32-C5; File version: 0.1
ESP32-C5 modem/radio registers owned by the radio drivers. This first stage publishes the IEEE 802.15.4 MAC aperture, its interrupt route and the modem ETM channels it programs, and the modem clock gates and resets of its vendor clock devices, the analog register I2C master the PHY drives, and Wi-Fi MAC register views derived from the reviewed ESP32-S31 model. Unknown fields are omitted.
Registers are 32-bit, read-write, no defined reset value unless marked. A register's access mark holds for its fields unless they carry their own. Offsets are from the block's base; lines under a group give offsets from that group; [hi:lo] are bit positions; {n}, {i} and the like mark numbered series; 'fields as' and 'values as' point back to an identical list; <NAME> marks a mode.

## Memory map
0x6000E000 APB_SARADC_RADIO — ESP32-C5 APB_SARADC field the PHY's power-detector initialization drives. Other fields remain absent and are preserved by every field transaction.
0x60010030 IEEE802154_INTERRUPT_ROUTE — The CPU interrupt-matrix word for ESP32-C5 modem source 12 (ZB_MAC). This source-specific view is retained with the IEEE 802.15.4 owner and publishes only the generated field readers needed to prove that a polled or validation transaction starts with the CPU route detached.
0x60096000 PCR_RADIO — ESP32-C5 PCR fields the PHY drives: the SAR ADC and temperature-sensor clocks and one word the public header does not describe. Other fields remain absent and are preserved by every field transaction.
0x600A0000 PHY_BASEBAND_CONFIG — ESP32-C5 PHY baseband configuration words recovered from complete pinned libphy leaves. Operation-derived fields keep UNKNOWN where no public documentation establishes their electrical meaning.
0x600A3000 IEEE802154_MAC — Dedicated ESP32-C5 IEEE 802.15.4 MAC aperture at 0x600A3000. This selective foundation publishes only register geometry exercised by the pinned public common/chip LL accessors. The public struct and register headers still carry TODO ZB-93 pending an authoritative regdesc CSV, so untouched DTM, timing, debug-selector and modem-sleep words remain deliberately absent and no reset values are claimed.
0x600A4000 WIFI_MAC_BSSID_POLICY — Per-interface BSSID address and policy words used by scan and associated-STA receive filtering.
0x600A405C WIFI_MAC_INTERFACE_ADDRESS — Four interface-address pairs consumed by MAC receive filtering.
0x600A42B4 WIFI_MAC_STA_BEACON_FILTER — Station beacon-filter control word recovered from the complete enable and disable leaves. The three low bits are toggled together; individual hardware meanings remain unknown.
0x600A4C40 WIFI_MAC_INTERRUPT — Wi-Fi MAC interrupt mask, masked status and write-to-clear aperture. The two complete hal_mac leaves independently prove the status and clear addresses. The recovered common FIQ and cold initializer prove the event-bit mapping and mask transaction used by the open ISR.
0x600A4C5C WIFI_MAC_TX_COMMON — Shared Wi-Fi CCA, timeout and completion state used by MAC transmit queues and the PHY-owned Wi-Fi CCA gate.
0x600A8800 MODEM_ETM — ESP32-C5 modem event-task matrix at MODEM_BASE + 0x8800. The public IEEE 802.15.4 driver names the channel-enable, set and clear words and the per-channel event/task pair at an eight-byte stride from 0x18, and programs channels zero and one. Other channels and identifiers remain absent and no reset values are claimed.
0x600A9C00 MODEM_SYSCON_RADIO — ESP32-C5 MODEM_SYSCON clock gates and resets at MODEM_BASE + 0x9C00 driven by the vendor modem clock devices of the IEEE 802.15.4 module (802154_MAC, BT_I154_COMMON_BB, ETM, BT_APB) and its MAC reset. Other fields remain absent and are preserved by every field transaction.
0x600AD814 WIFI_MAC_STA_TSF_LOAD — Shared station TSF load and coherent snapshot transaction.
0x600AD830 WIFI_MAC_RTC_TIMER_UPDATE — Complete enabled path of hal_timer_update_by_rtc, reached from complete hal_init with enable one and the OS-adapter slow-clock calibration value.
0x600AD860 WIFI_MAC_AUX_TSF_CONTROL — SoftAP, NAN and broadcast-TWT TSF control words. Complete public leaves prove their addresses and exact enable/mode masks; unrelated bits and hardware transition rules remain unnamed.
0x600AD8B0 WIFI_MAC_POWER_INTERRUPT — WDEVPWR interrupt bank named by complete print_isr_regs. Complete hal_pwr_interrupt_get_event and hal_pwr_interrupt_clr_event independently prove the masked STATUS read and full-width CLEAR acknowledgement transaction. Complete TSF timer enable/disable leaves update the timer interrupt masks in ENABLE and clear stale events through CLEAR.
0x600AF000 MODEM_LPCON_SHARED_CLOCK — ESP32-C5 MODEM_LPCON clock gate at MODEM_BASE + 0xF000 driven by the vendor COEXIST modem clock device, and the power-state map of the analog I2C master clock. Other fields remain absent and are preserved by every field transaction.
0x600AF800 I2C_ANA_MST — ESP32-C5 analog register I2C master at MODEM_BASE + 0xF800: the two command hosts, the read-mask word and the host-selection field that the libphy analog-register leaves drive. Other fields remain absent and are preserved by every field transaction.
0x600B0000 PMU_RADIO — ESP32-C5 PMU fields that the PHY drives: the analog I2C power and reset controls of the RF blocks and the immediate BB I2C power tie. Other fields remain absent and are preserved by every field transaction.
0x600B1000 LP_AON_RADIO — ESP32-C5 LP_AON field the PHY's power-detector SAR initialization drives. Other fields remain absent and are preserved by every field transaction.

## Licence text in the file
MIT OR Apache-2.0
